## sdkconfig.defaults
```kconfig
# ESP32-S3 Waveshare 2.8" Touch LCD
# Target: 240x320 ST7789 + CST328 + PCM5101 I2S

# CPU
CONFIG_IDF_TARGET="esp32s3"
CONFIG_ESP_DEFAULT_CPU_FREQ_MHZ_240=y

# Flash
CONFIG_ESPTOOLPY_FLASHSIZE_16MB=y
CONFIG_ESPTOOLPY_FLASHMODE_QIO=y
CONFIG_ESPTOOLPY_FLASHFREQ_80M=y

# PSRAM
CONFIG_SPIRAM=y
CONFIG_SPIRAM_MODE_OCT=y
CONFIG_SPIRAM_SPEED_80M=y

# Partition table
CONFIG_PARTITION_TABLE_CUSTOM=y
CONFIG_PARTITION_TABLE_CUSTOM_FILENAME="partitions.csv"

# FreeRTOS
CONFIG_FREERTOS_HZ=1000
CONFIG_FREERTOS_TIMER_TASK_STACK_DEPTH=4096

# Main task stack
CONFIG_ESP_MAIN_TASK_STACK_SIZE=16384

# Watchdog - disable for tight game loop
CONFIG_ESP_TASK_WDT_ENABLED=n

# Console via USB Serial JTAG (frees GPIO 43/44)
CONFIG_ESP_CONSOLE_USB_SERIAL_JTAG=y

# Optimization
CONFIG_COMPILER_OPTIMIZATION_PERF=y

# Instruction cache
CONFIG_ESP32S3_INSTRUCTION_CACHE_16KB=y
CONFIG_ESP32S3_INSTRUCTION_CACHE_8WAY=y

# Data cache
CONFIG_ESP32S3_DATA_CACHE_32KB=y
CONFIG_ESP32S3_DATA_CACHE_8WAY=y

# SPIFFS
CONFIG_SPIFFS_MAX_PARTITIONS=3
```
